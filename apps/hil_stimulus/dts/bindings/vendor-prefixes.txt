## dts/bindings/uc,io-channels.yaml
```yaml
# SPDX-License-Identifier: Apache-2.0

description: |
  BACnet-uc IO channel catalog.

  Declares the physical (or simulated) IO channels a board offers to the
  BACnet-uc firmware. Each child node is one channel; the node name is the
  channel name used in io.json, by the management interface and by
  WebAssembly applications (uc_io_find()).

  Example:

    uc_io: uc-io {
      compatible = "uc,io-channels";
      board-name = "nucleo_f767zi";

      di0 {
        kind = "di";
        gpios = <&gpioc 13 GPIO_ACTIVE_HIGH>;
        description = "User button B1";
      };
      do0 {
        kind = "do";
        gpios = <&gpiob 0 GPIO_ACTIVE_HIGH>;
        description = "LD1 green";
      };
      ai0 {
        kind = "ai";
        io-channels = <&adc1 3>;
        description = "A0 (PA3)";
      };
      ao0 {
        kind = "ao";
        pwms = <&pwm1 1 PWM_MSEC(1) PWM_POLARITY_NORMAL>;
        description = "D6 (PE9) PWM";
      };
      ai9 {
        kind = "ai";
        simulated;
        description = "Virtual analog input";
      };
    };

compatible: "uc,io-channels"

properties:
  board-name:
    type: string
    description: Board name reported in the IO catalog.

child-binding:
  description: One IO channel.
  properties:
    kind:
      type: string
      required: true
      enum: ["di", "do", "ai", "ao"]
      description: |
        di: digital input (GPIO), do: digital output (GPIO),
        ai: analog input (ADC, value in mV), ao: analog output (PWM duty 0..100 %).
    description:
      type: string
      description: Human readable description (connector pin, function).
    gpios:
      type: phandle-array
      description: GPIO for di/do channels.
    io-channels:
      type: phandle-array
      description: |
        ADC channel for ai channels. The ADC node must contain a matching
        channel@N child with the standard zephyr,gain/zephyr,reference/
        zephyr,acquisition-time/zephyr,resolution properties.
    pwms:
      type: phandle-array
      description: PWM channel (with period) for ao channels.
    simulated:
      type: boolean
      description: |
        Channel without hardware. Its value is held in RAM and set through
        the management interface (uc_io force). Used on native_sim and for
        virtual points on real boards.
    initial-value:
      type: int
      default: 0
      description: Initial value of a simulated channel (integer engineering units).
```

## firmware/tests/unit/testcase.yaml
```yaml
# SPDX-License-Identifier: Apache-2.0
common:
  tags:
    - bacnet_uc
    - unit
tests:
  bacnet_uc.unit.common_config:
    platform_allow:
      - native_sim/native/64
    integration_platforms:
      - native_sim/native/64
```

## lib/hil/Kconfig
```kconfig
# SPDX-License-Identifier: Apache-2.0
#
# lib/hil (docs/HIL.md 8.3). Enabled only by snippets/hil/hil.conf; release images never set
# these symbols (SEC-01 checks their .config).

config HIL
	bool "HIL rig instrumentation (lib/hil)"
	depends on HWINFO
	help
	  Instrumented DUT images for the BACNet-uc HIL rig. Prints
	  "HIL-BOOT board=... zephyr=... reset=0x... uid=..." before main()
	  and "HIL-READY ip=... mac=..." whenever the DUT gains an IPv4
	  address, and toggles marker m0 at both lines. The markers are the
	  hil-marker-gpios of /zephyr,user (snippet hil). Never enable this in
	  a release image.

if HIL

config HIL_SHELL
	bool "hil shell commands"
	depends on SHELL
	default y
	help
	  Shell group "hil": "hil info", "hil mark <n> <0|1|t>" and
	  "hil panic" (a kernel panic, to test fatal-error recovery).
	  Every command prints exactly one "OK ..." or "ERR -<errno> <text>"
	  line, like the stimulus protocol.

endif # HIL
```

## modules/wasm-micro-runtime/Kconfig
```kconfig
# SPDX-License-Identifier: Apache-2.0
#
# Kconfig glue for the WebAssembly Micro Runtime (WAMR). WAMR's module.yml
# declares kconfig-ext/cmake-ext, the glue lives here (module_ext_root).

config ZEPHYR_WASM_MICRO_RUNTIME_MODULE
	bool

menuconfig WAMR
	bool "WebAssembly Micro Runtime (WAMR)"
	depends on ZEPHYR_WASM_MICRO_RUNTIME_MODULE
	help
	  Build the WAMR runtime library (interpreter and optionally the AOT
	  loader) into the image.

if WAMR

config WAMR_BUILD_TARGET
	string "WAMR build target"
	default "THUMBV7EM_VFP" if (CPU_CORTEX_M7 || CPU_CORTEX_M4) && FP_HARDABI
	default "THUMBV7EM" if CPU_CORTEX_M7 || CPU_CORTEX_M4
	default "THUMBV8M.MAIN_VFP" if (CPU_CORTEX_M33 || CPU_CORTEX_M55) && FP_HARDABI
	default "THUMBV8M.MAIN" if CPU_CORTEX_M33 || CPU_CORTEX_M55
	default "THUMBV7M" if CPU_CORTEX_M3
	default "X86_64" if ARCH_POSIX && 64BIT
	default "X86_32" if ARCH_POSIX
	help
	  Value passed as WAMR_BUILD_TARGET. The "_VFP" suffix selects the
	  hard-float calling convention and must match CONFIG_FP_HARDABI. The
	  part before the suffix, lower-cased, is the target an AOT file must
	  have been compiled for (wamrc --target=...).

config WAMR_FAST_INTERP
	bool "Fast interpreter"
	default y
	help
	  Use WAMR's fast interpreter (pre-compiled internal bytecode, roughly
	  2x faster than the classic interpreter, ~2x more RAM per module).

config WAMR_AOT
	bool "AOT module loader"
	help
	  Allow loading ahead-of-time compiled modules produced by wamrc
	  (wasm/sdk/uc-aot). Off by default. AOT code is loaded into the WAMR
	  pool and executed there, so the pool must be executable:

	  - WAMR 2.4.5's own MPU handling (disable_mpu_rasr_xn() from
	    bh_platform_init()) is broken and not built: on ARMv7-M it ORs
	    ~XN into RASR of every region with XN, which switches those
	    regions off (4 GiB, all subregions disabled) instead of clearing
	    XN; on ARMv8-M it does nothing, SRAM stays execute-never.
	  - Instead the application manager checks at start, from the MPU
	    registers, that the pool is executable (wamr_zephyr_exec_enable())
	    and refuses AOT files otherwise. With Zephyr's default MPU setup
	    (CONFIG_XIP=y) it is not: NUCLEO-F767ZI (pool in DTCM, covered by
	    the SRAM region with XN) and FRDM-MCXN947 (pool in SRAMX, its own
	    RAM region with XN). WAMR_AOT_MPU_EXEC clears XN of those regions.
	  - native_sim: the pool pages are made executable with mprotect().

	  Cortex-M AOT files must use indirect mode (uc-aot's default): in
	  direct mode LLVM emits calls to __aeabi_memclr, which WAMR 2.4.5's
	  aot_reloc_thumb.c symbol map lacks. WAMR has no way to add symbols
	  to that map from outside (the map also sizes the PLT), so the glue
	  does not try. The application watchdog stops an AOT callback only if
	  the file was compiled with --enable-multi-thread (uc-aot's default)
	  and CONFIG_WAMR_THREAD_MGR=y; WAMR_INSTRUCTION_LIMIT does not apply
	  to AOT code.

config WAMR_AOT_MPU_EXEC
	bool "Clear XN of the MPU regions holding the WAMR pool"
	depends on WAMR_AOT && ARM_MPU
	help
	  Acknowledges that AOT code executes from RAM on an ARM MPU target:
	  at start, the XN attribute of the enabled MPU regions that decide
	  the access to the WAMR pool is cleared (ARMv7-M RASR.XN, ARMv8-M
	  RBAR.XN; nothing else changes). Such a region becomes executable as
	  a whole: on NUCLEO-F767ZI the SRAM region (all of SRAM including
	  DTCM, like a CONFIG_XIP=n image), on FRDM-MCXN947 the SRAMX region
	  (only the pool). Without it, AOT files are refused on these boards.

config WAMR_BULK_MEMORY
	bool "Bulk memory operations"
	default y
	help
	  Needed by modules built with recent clang/LLVM, which emit
	  memory.copy/memory.fill by default.

config WAMR_REF_TYPES
	bool "Reference types"
	default y
	help
	  Needed by modules built with LLVM >= 19, which enables the
	  reference-types feature for wasm32 by default.

config WAMR_THREAD_MGR
	bool "Thread manager (interruptible execution)"
	help
	  Build WAMR's thread manager. Wasm threads stay disabled; what the
	  embedder gets is the suspend-flag check the interpreter then
	  performs on every branch and call: wasm_runtime_terminate() sets
	  the terminate flag, so a module stuck in a loop stops at its next
	  branch. Without the thread manager wasm_runtime_terminate() only
	  records an exception that is noticed after the running call has
	  returned by itself. Each exec env gets its own cluster; the module's
	  aux stack is not split into per-thread segments
	  (WASM_ENABLE_HEAP_AUX_STACK_ALLOCATION=1). AOT code checks the flags
	  only when it was compiled with thread manager support
	  (wamrc --enable-multi-thread).

config WAMR_INSTRUCTION_LIMIT
	int "Instruction budget of one call into a module (0: unlimited)"
	range 0 2147483647
	default 100000000 if ARCH_POSIX
	default 0
	help
	  Builds WAMR with instruction metering (WAMR_BUILD_INSTRUCTION_METERING)
	  and gives every call into a module (every application callback)
	  this many interpreted instructions; a call that exceeds it traps with
	  "instruction limit exceeded". Interpreter only, not AOT code.

	  Meant for native_sim, where the application watchdog
	  (CONFIG_UC_APP_WATCHDOG_MS) cannot stop a callback that never
	  blocks: simulated time only advances while the simulated CPU idles,
	  so the watchdog timer does not expire during a busy loop and the
	  whole node would hang. 100 million instructions take roughly 0.1 to
	  0.5 s on a PC. On the boards the watchdog works in real time and the
	  metering (one counter update per instruction) is left out.

config WAMR_LOG
	bool "Runtime diagnostics"
	default y

endif # WAMR
```
